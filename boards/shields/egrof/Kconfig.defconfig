## boards/shields/egrof/Kconfig.defconfig
```kconfig
if SHIELD_CHARYBDIS_DONGLE

config ZMK_KEYBOARD_NAME
	default "Egrof"

config ZMK_SPLIT_ROLE_CENTRAL
	default y

endif

if SHIELD_EGROF_DONGLE || SHIELD_EGROF_LEFT || SHIELD_EGROF_RIGHT

config ZMK_SPLIT
	default y
	
endif
```

## boards/shields/egrof/Kconfig.shield
```kconfig
config SHIELD_EGROF_DONGLE
	def_bool $(shields_list_contains,egrof_dongle)

config SHIELD_EGROF_LEFT
	def_bool $(shields_list_contains,egrof_left)

config SHIELD_EGROF_RIGHT
	def_bool $(shields_list_contains,egrof_right)
```

## boards/shields/falkor/Kconfig.defconfig
```kconfig
if SHIELD_FALKOR_DONGLE

config ZMK_KEYBOARD_NAME
	default "Falkor"

config ZMK_SPLIT_ROLE_CENTRAL
	default y

config ZMK_STUDIO
	default y

endif

if SHIELD_FALKOR_DONGLE || SHIELD_FALKOR_LEFT || SHIELD_FALKOR_RIGHT

config ZMK_SPLIT
	default y
	
endif
```

## boards/shields/falkor/Kconfig.shield
```kconfig
config SHIELD_FALKOR_DONGLE
	def_bool $(shields_list_contains,falkor_dongle)

config SHIELD_FALKOR_LEFT
	def_bool $(shields_list_contains,falkor_left)

config SHIELD_FALKOR_RIGHT
	def_bool $(shields_list_contains,falkor_right)
```

## config/west.yml
```yaml
manifest:
  remotes:
    - name: wdtamagi
      url-base: https://github.com/wdtamagi
    - name: badjeff
      url-base: https://github.com/badjeff
    - name: nrfconnect
      url-base: https://github.com/nrfconnect
  projects:
    - name: zmk
      remote: wdtamagi
      revision: main
      import: app/west.yml
    - name: nice-view-gem
      remote: wdtamagi
      revision: main
    - name: zmk-pmw3610-driver
      remote: wdtamagi
      revision: main
    - name: zmk-behavior-mouse-key-toggle
      remote: badjeff
      revision: main
    - name: zmk-output-behavior-listener
      remote: badjeff
      revision: main
    - name: zmk-input-processor-mixer
      remote: badjeff
      revision: main
    - name: zmk-input-processor-report-rate-limit
      remote: badjeff
      revision: main
    - name: zmk-input-processor-xyz
      remote: badjeff
      revision: main
    - name: zmk-dongle-screen
      remote: wdtamagi
      revision: main
    - name: zmk-feature-split-esb
      remote: badjeff
      revision: main  
    - name: sdk-nrf
      remote: nrfconnect
      revision: v2.6.4 # zephyr v3.5.99
      path: nrf
    - name: nrfxlib
      remote: nrfconnect
      revision: v2.6.4
      repo-path: sdk-nrfxlib
      path: nrfxlib
  self:
    path: config
```
