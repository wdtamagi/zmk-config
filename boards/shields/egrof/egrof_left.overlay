#include "egrof.dtsi"
#include "egrof_3610.dtsi"
#include "egrof_nview.dtsi"

&kscan0 {
	compatible = "zmk,kscan-gpio-matrix";
	
  col-gpios
      = <&gpio1 6 GPIO_ACTIVE_HIGH>
      , <&gpio1 4 GPIO_ACTIVE_HIGH>
      , <&gpio0 11 GPIO_ACTIVE_HIGH>
      , <&gpio1 0 GPIO_ACTIVE_HIGH>
      ;
  row-gpios
      = <&gpio0 31 (GPIO_ACTIVE_HIGH | GPIO_PULL_DOWN)>
      , <&gpio0 29 (GPIO_ACTIVE_HIGH | GPIO_PULL_DOWN)>
      , <&gpio0 2 (GPIO_ACTIVE_HIGH | GPIO_PULL_DOWN)>
      , <&gpio1 15 (GPIO_ACTIVE_HIGH | GPIO_PULL_DOWN)>
      , <&gpio1 13 (GPIO_ACTIVE_HIGH | GPIO_PULL_DOWN)>
      , <&gpio1 11 (GPIO_ACTIVE_HIGH | GPIO_PULL_DOWN)>
      , <&gpio0 10 (GPIO_ACTIVE_HIGH | GPIO_PULL_DOWN)>
      , <&gpio0 9 (GPIO_ACTIVE_HIGH | GPIO_PULL_DOWN)>
      ;
};

/ {
	vtrackball: virtual_input_trackball {
		compatible = "zmk,virtual-input";
	};
};
